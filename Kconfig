## Kconfig
```kconfig
# SPDX-License-Identifier: GPL-2.0
#
# For a description of the syntax of this configuration file,
# see Documentation/kbuild/kconfig-language.txt.
#
mainmenu "Linux/$ARCH $KERNELVERSION Kernel Configuration"

config SRCARCH
	string
	option env="SRCARCH"

source "arch/$SRCARCH/Kconfig"

config CASUAL_USER_BUILD
	bool "Disables difficult things for those who do not need them"
	default y
	select BROKEN_PRINTK
	help
	  No help while you are using this config.

config BROKEN_PRINTK
	def_bool n
```
